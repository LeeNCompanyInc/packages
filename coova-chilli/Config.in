## coova-chilli/Config.in
```kconfig
# CoovaChilli advanced configuration

menu "Configuration"
	depends on PACKAGE_coova-chilli

config COOVACHILLI_PROXY
        bool "Enable support for chilli proxy. Required for AAA Proxy through http"
        default n

config COOVACHILLI_RADPROXY
        bool "Enable chilli RADIUS (EAP) Proxy support"
        default n

config COOVACHILLI_JSON
        bool "Enable support for JSON"
        default y

config COOVACHILLI_DHCPRADIUS
		bool "Support DHCP/RADIUS integration"
		default y

config COOVACHILLI_DHCPOPT
	bool "Enable support for DHCP option setting"
	default n

config COOVACHILLI_SESSIONPROXY
	bool "Enable support for per session postauth proxy"
	default n

config COOVACHILLI_CONFIG_ATTRIBUTE
	bool "Enable the use of the CoovaChilli-Config attribute"
	default y

config COOVACHILLI_NETBIOS
	bool "Enable support for NetBIOS"
	default n

config COOVACHILLI_TAP
	bool "Enable support for TAP interface"
	default y

config COOVACHILLI_ACCOUNTING_ONOFF
	bool "Enable support for Accounting-On and Accounting-Off"
	default y

config COOVACHILLI_UAMUIPORT
	bool "Enable use of uamuiport"
	default y

config COOVACHILLI_UAMANYIP
	bool "enable use of uamanyip"
	default y

config COOVACHILLI_CHILLIQUERY
	bool "enable chilli_query"
	default y

config COOVACHILLI_REDIR
	bool "Enable support for redir server. Required for uamregex"
	default n

config COOVACHILLI_MINIPORTAL
	bool "Enable support Coova miniportal"
	default n

config COOVACHILLI_USERAGENT
	bool "Enable recording user-agent"
	default n

config COOVACHILLI_DNSLOG
	bool "Enable support to log DNS name queries"
	default n

config COOVACHILLI_UAMDOMAINFILE
	bool "Enable loading of mass uamdomains from file"
	default n

config COOVACHILLI_LARGELIMITS
	bool "Enable larger limits for use with non-embedded systems"
	default n

config COOVACHILLI_MINICONFIG
	bool "Enable support minimal command-line config"
	default n

config COOVACHILLI_BINSTATUSFILE
	bool "Enable binary status file"
	default n

config COOVACHILLI_LAYER3
	bool "Enable Layer 3 mode"
	default n

config COOVACHILLI_LEAKYBUCKET
	bool "Enable to use of leaky bucket rate shaping."
	default n

config COOVACHILLI_STATUSFILE
	bool "Enable status file"
	default n

config COOVACHILLI_RTMON
	bool "Enable support for route monitoring deamon (experimental)"
	default n

config COOVACHILLI_CURL
	bool "enable support for curl (optional and used with --enable-chilliproxy)"
	default n

config COOVACHILLI_WPAD
	bool "enable support WPAD"
	default n

config COOVACHILLI_COA
	bool "enable CoA RADIUS support"
	default y

config COOVACHILLI_IEEE8021Q
	bool "enable support for IEEE 802.1Q"
	default y

config COOVACHILLI_DEBUG
	bool "enable debugging messages"
	default n

config COOVACHILLI_DEBUG2
	bool "enable more verbose messages"
	default n

config COOVACHILLI_NETBIOS
	bool "enable support for NetBIOS"
	default n

config COOVACHILLI_NFQUEUE
	bool "enable support for netfilter_nfqueue"
	default n

config COOVACHILLI_IEEE8023
	bool "enable support for IEEE 802.3 Ethernet"
	default n

config COOVACHILLI_REDIRINJECT
	bool "enable redirect content-injection support"
	default n

config COOVACHILLI_NETNAT
	bool "enable net interface nat (expermental)"
	default n

config COOVACHILLI_LOCATION
	bool "enable Location Awareness"
	default n

config COOVACHILLI_FORCEDNS
	bool "enable the forcing (NAT of) DNS"
	default n

config COOVACHILLI_MMAP
	bool "enable mmap"
	default n

config COOVACHILLI_POLL
	bool "enable poll"
	default n

choice
	prompt "SSL library"
	default COOVACHILLI_NOSSL

config COOVACHILLI_NOSSL
	bool "No SSL support"

config COOVACHILLI_MATRIXSSL
	bool "MatrixSSL"

config COOVACHILLI_CYASSL
	bool "CyaSSL"

config COOVACHILLI_OPENSSL
	bool "OpenSSL"

endchoice

endmenu
```

## n2n-v2/Config.in
```kconfig
menu "Configuration"
    depends on PACKAGE_n2n-v2

config CONFIG_N2N_AES_ENCRYPTION
    bool "Use AES Encryption"
    depends on PACKAGE_n2n-v2
    default n

endmenu
```
